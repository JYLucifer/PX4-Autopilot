## src/drivers/distance_sensor/tofsense/Kconfig
```kconfig
menuconfig DRIVERS_DISTANCE_SENSOR_TOFSENSE
    bool "tofsense"
    default n
    ---help---
		Enable support for tofsense
```

## src/drivers/distance_sensor/tofsensem/Kconfig
```kconfig
menuconfig DRIVERS_DISTANCE_SENSOR_TOFSENSEM
    bool "tofsensem"
    default n
    ---help---
        Enable support for tofsensem
```

## src/drivers/uwb/Kconfig
```kconfig
menu "UWB"
    menuconfig COMMON_UWB
        bool "common UWB Drivers"
        default n
        select DRIVERS_UWB_UWB_SR150
	select DRIVERS_UWB_LINKTRACK
	select DRIVERS_UWB_LINKTRACK_AOA
        ---help---
            Enable support for uwb drivers
    rsource "*/Kconfig"
endmenu
```

## src/drivers/uwb/linktrack/Kconfig
```kconfig
menuconfig DRIVERS_UWB_LINKTRACK
    bool "linktrack"
    default n
    ---help---
        Enable support for linktrack
```

## src/drivers/uwb/linktrack_aoa/Kconfig
```kconfig
menuconfig DRIVERS_UWB_LINKTRACK_AOA
    bool "linktrack_aoa"
    default n
    ---help---
        Enable support for linktrack_aoa
```
